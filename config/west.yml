## config/west.yml
```yaml
manifest:
  remotes:
    - name: danielsvane
      url-base: https://github.com/danielsvane
    #
    # Add more remotes here to pull in out-of-tree modules with your own
    # boards, shields, or behaviour code.
    - name: SasorizaTsugare
      url-base: https://github.com/SasorizaTsugare
  projects:
    - name: zmk
      remote: danielsvane
      revision: customkeyboards
      import: app/west.yml
      # support nice_oled and nice_epaper
    - name: zmk-nice-oled-fromgitlab
      remote: SasorizaTsugare
      revision: main
  self:
    path: config
```
